## conf/distro/include/distro-multilib.inc
```bitbake
# This file should be split into distro-${ARCH}-multilib.inc and have a top-level include do 'require  distro-${ARCH}-multilib.inc'.
# Since BSPs suck pay attentions to the arm-defaults.inc comment below

# Install 64bit into ${prefix}/lib64 and ${prefix}/lib32
# FIXME: use debian multi-arch style paths
#BASELIB_aarch64 = "lib"

BASELIB_tune-armv7ahf-neon = "lib32"
BASELIB_armv7a = "lib"

require conf/multilib.conf
MULTILIBS = "multilib:lib32"

# Merge with conf/distro/inclue/arm-defaults.inc?
DEFAULTTUNE_virtclass-multilib-lib32 = "armv7ahf-neon"

# Enforce RPM, opkg and dpkg can't parallel install multilib conflicts
PACKAGE_CLASSES = "package_rpm"
```

## conf/distro/include/egl.inc
```bitbake
MALI_USERLAND_LIBARIES ?= "mali450-userland"
SGX_USERLAND_LIBARIES ?= "ti-sgx-ddk-um"

# Helper function for overloading the default EGL/GLES implementation.
# The Mali libraries provided by ARM are compatible with the Mesa headers
# and it is safe to use with user space applications linked against Mesa.

def get_egl_handler(d, target):
    """  Overloading the default EGL/GLES/MESA implementation."""
    features = d.getVar('MACHINE_FEATURES', True).split()

    mali_libs = d.getVar('MALI_USERLAND_LIBARIES', True);
    sgx_libs = d.getVar('SGX_USERLAND_LIBARIES', True);

    if 'mali450' in features:
        if target == 'mesa' or target == 'libgl':
            provider = "mesa"
        else:
            provider = mali_libs.split()[0]
    elif 'sgx' in features:
        if target == 'mesa' or target == 'libgl':
            provider = "mesa-gl"
        else:
            provider = sgx_libs.split()[0]
    else:
        provider = "mesa"

    return provider;

PREFERRED_PROVIDER_virtual/libgl = "${@get_egl_handler(d, 'libgl')}"
PREFERRED_PROVIDER_virtual/egl = "${@get_egl_handler(d, 'egl')}"
PREFERRED_PROVIDER_virtual/libgles1 = "${@get_egl_handler(d, 'libgles1')}"
PREFERRED_PROVIDER_virtual/libgles2 = "${@get_egl_handler(d, 'libgles2')}"
PREFERRED_PROVIDER_virtual/mesa = "${@get_egl_handler(d, 'mesa')}"
```

## conf/distro/include/mali.inc
```bitbake
MALI_USERLAND_LIBARIES ?= "mali450-userland"

# Helper function for overloading the default EGL/GLES implementation.
# The Mali libraries provided by ARM are compatible with the Mesa headers
# and it is safe to use with user space applications linked against Mesa.

def get_mali_handler(d, target):
    """  Overloading the default EGL/GLES implementation."""
    features = d.getVar('MACHINE_FEATURES', True).split()

    mali_libs = d.getVar('MALI_USERLAND_LIBARIES', True);

    if(mali_libs):
        mali_libs = mali_libs.split()

    if 'mali450' in features and mali_libs:
        provider = mali_libs[0]
    else:
        provider = "mesa"

    return provider;

PREFERRED_PROVIDER_virtual/egl := "${@get_mali_handler(d, 'egl')}"
PREFERRED_PROVIDER_virtual/libgles1 = "${@get_mali_handler(d, 'libgles1')}"
PREFERRED_PROVIDER_virtual/libgles2 = "${@get_mali_handler(d, 'libgles2')}"
```

## conf/distro/include/rpb.inc
```bitbake
DISTRO_VERSION = "3.0+linaro"

# These default to 'oecore' and 'nodistro'
SDK_NAME_PREFIX = "${DISTRO}"
SDK_VERSION = "${DISTRO_VERSION}"

TARGET_VENDOR = "-linaro"

require conf/distro/include/arm-defaults.inc
require conf/distro/include/egl.inc

# defaultsetup.inc gets includes after ${DISTRO}.conf, so we need to set it here
# to make the python below work. Local, site and auto.conf will override it.
TCMODE ?= "default"

# Enable multilib conditionally, only for aarch64 with default toolchain combination
# Other combinations aren't supported
def get_multilib_handler(d):
    features = d.getVar('TUNE_FEATURES', True).split()
    tcmode = d.getVar('TCMODE', True)
    if ('aarch64' in features) and (tcmode == "default"):
        distro_multilib = "conf/distro/include/distro-multilib.inc"
    else:
        distro_multilib = "conf/distro/include/file-cannot-be-found.inc"
    return distro_multilib

# Use a weak include to avoid to produce an error when the file cannot be found.
# It is the case when we don't want multilib enabled (e.g. on 32bit machines).
#include ${@get_multilib_handler(d)}

GCCVERSION ?= "arm-10.3"

DISTRO_FEATURES:append = " opengl pam systemd ptest vulkan"
DISTRO_FEATURES:remove = "3g sysvinit"
VIRTUAL-RUNTIME_init_manager = "systemd"
PACKAGECONFIG:append:pn-systemd = " resolved networkd"
PACKAGECONFIG:append:pn-qtbase = " gles2 fontconfig examples"
PACKAGECONFIG:remove:pn-gpsd = "qt"
PACKAGECONFIG:append:pn-gstreamer1.0-plugins-bad = " kms"
PACKAGECONFIG:append:pn-ffmpeg = " sdl2"
PACKAGECONFIG:append:pn-igt-gpu-tools = " chamelium"

PREFERRED_PROVIDER_iasl-native = "acpica-native"
PREFERRED_PROVIDER_iasl = "acpica"

LICENSE_FLAGS_WHITELIST += "commercial_gstreamer1.0-libav commercial_ffmpeg commercial_x264 non-commercial"

# Avoid to duplicate the rootfs tarball by generating both tar.gz/tar.xz
IMAGE_FSTYPES:remove = "tar.gz"

# By default, meta-ti and TI SDK ship tar.xz rootfs tarball for SD card deployment
# fastboot is preferred for deployment in automation
IMAGE_FSTYPES:append:omap-a15 = " ext4.gz"
IMAGE_FSTYPES:append:beaglebone = " ext4.gz"

INHERIT += "buildhistory"
INHERIT += "image-buildinfo"
BUILDHISTORY_COMMIT = "1"
```

## conf/distro/rpb-eglfs.conf
```bitbake
require conf/distro/include/rpb.inc

DISTRO_NAME = "Reference-Platform-Build-EGLFS"

PACKAGECONFIG:append:pn-qtbase = " eglfs kms gbm"

DISTRO_FEATURES:remove = "wayland x11"
DISTROOVERRIDES = "rpb:rpb-eglfs"
```

## conf/distro/rpb-sota.conf
```bitbake
require conf/distro/include/rpb.inc
require conf/distro/sota.conf.inc

DISTRO_NAME = "Reference-Platform-Build-SOTA"

OSTREE_OSNAME = "oe-rpb"
OSTREE_INITRAMFS_FSTYPES = "cpio.gz"
IMAGE_BOOT_FILES_sota = " ${KERNEL_IMAGETYPE}"
```

## conf/distro/rpb-wayland.conf
```bitbake
require conf/distro/include/rpb.inc

DISTRO_NAME = "Reference-Platform-Build-Wayland"

DISTRO_FEATURES:append = " wayland"
DISTRO_FEATURES:remove = "x11"

PREFERRED_PROVIDER_libgbm:omap-a15 = "libgbm"
PREFERRED_PROVIDER_libgbm-dev:omap-a15 = "libgbm-dev"
DISTROOVERRIDES = "rpb:rpb-wayland"
```

## conf/distro/rpb-x11.conf
```bitbake
DISTRO_NAME = "Reference-Platform-Build-X11"

GCCVERSION = "linaro-5.2"

DISTRO_FEATURES_append = " x11 systemd"
DISTRO_FEATURES_remove = "wayland sysvinit"

VIRTUAL-RUNTIME_init_manager = "systemd"
```

## conf/distro/rpb.conf
```bitbake
require conf/distro/include/rpb.inc

DISTRO_NAME = "Reference-Platform-Build-X11"

DISTRO_FEATURES:append = " x11"
DISTRO_FEATURES:remove = "wayland"
```
